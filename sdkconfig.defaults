## sdkconfig.defaults
```kconfig
CONFIG_BLINK_LED_GPIO=y
CONFIG_BLINK_GPIO=8
# PHY: shut off MAC & BB when unused
CONFIG_PHY_PWR_DOWN_MAC_BASEBAND_WHEN_PHY_DISABLED=y

# BLE controller: modem sleep
CONFIG_BT_CTRL_MODEM_SLEEP=y
CONFIG_BT_CTRL_MODEM_SLEEP_MODE_1=y

# choose your low-power clock for modem sleep
# (either main XTAL, 32 kHz XTAL, or RTC slow—here we keep XTAL)
CONFIG_BT_CTRL_LPCLK_SEL_MAIN_XTAL=y

# optionally keep XTAL powered during light sleep
CONFIG_BT_CTRL_PWR_UP_MAIN_XTAL=y
```
